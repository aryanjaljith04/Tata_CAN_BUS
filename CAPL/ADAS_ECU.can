/*@!Encoding:1252*/
/* ADAS_ECU.can
   Node    : ADAS_ECU
   Purpose : Periodic ADAS sensor data + bursty alert messages
   Author  : Aryan Jaljith | CB.EN.U4EEE2310 5
*/

variables {
  msTimer adasTimer;
  msTimer burstTimer;
  message 0x201 adasSensor;
  message 0x200 adasAlert;
  int     burstCount = 0;
  // Declare all local variables here
  float   dist       = 0.0;
  float   speed      = 0.0;
}

on start {
  adasSensor.dlc = 4;
  adasAlert.dlc  = 1;
  @sysvar::NodeStatus::Node_ADAS_Status = 1;
  setTimer(adasTimer, 50);
}

on timer adasTimer {
  // Assign values -- do not declare type here
  dist  = 50.0 + (random(5000) * 0.1);
  speed = 45.0 + (random(2000) * 0.01);

  adasSensor.word(0) = (word)(dist  / 0.1);
  adasSensor.word(2) = (word)(speed / 0.01);
  output(adasSensor);

  if(dist < 100.0) {
    adasAlert.byte(0) = 0x21;
    output(adasAlert);
    burstCount = 5;
    setTimer(burstTimer, 10);
  }

  setTimer(adasTimer, 50);
}

on timer burstTimer {
  if(burstCount > 0) {
    output(adasAlert);
    burstCount--;
    setTimer(burstTimer, 10);
  }
}
