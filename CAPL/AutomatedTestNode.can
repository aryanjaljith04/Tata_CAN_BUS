/* TestNode.can
   Purpose: Automated Test Execution for the IVN Project
   Covers Scenario 1 (Baseline), Scenario 2 (Flooded), Scenario 3 (Deferred)
*/

includes {
}

variables {
}

// Main execution block for the Test Module
void MainTest() {
  TestModuleTitle("IVN Safety and Deferral Algorithm - Exhaustive Test Suite");
  TestModuleDescription("Comprehensive validation of ISO-26262 compliance across all fault intensities, types, and mathematical edge cases.");

  // Reset everything to default before starting
  @sysvar::FaultInjection::StopFault = 1;
  @sysvar::CrashSafety::ResetCrash = 1;
  @sysvar::LoadManager::Alpha = 0.3;
  testWaitForTimeout(1000);

  // Run the test sequence
  TC1_Baseline_Control();
  TC2_Low_Intensity_Flood();
  TC3_Medium_Intensity_Flood();
  TC4_High_Intensity_Burst();
  TC5_High_Intensity_Burst_Defended();
  TC6_High_Intensity_Ramp_Defended();
  TC7_High_Intensity_Cascade_Defended();
  TC8_False_Positive_Check();
  TC9_Alpha_Too_Slow_Vulnerability();
}

void ResetTestState() {
  @sysvar::FaultInjection::StopFault = 1;
  @sysvar::CrashSafety::ResetCrash = 1;
  @sysvar::LoadManager::Alpha = 0.3;
  @sysvar::LoadManager::Threshold = 95.0; // Algo OFF by default
  testWaitForTimeout(2000); // Wait for bus to normalize
}

testcase TC1_Baseline_Control() {
  TestCaseTitle("TC1", "Baseline Idle Traffic");
  TestCaseDescription("Validates that under normal conditions, the bus is stable and crash latency is safe.");
  ResetTestState();
  
  TestStep("Execution", "Triggering Crash Sensor");
  @sysvar::CrashSafety::SimulateCrash = 1;
  if(testWaitForSysVar(sysvar::CrashSafety::AirbagDeployed, 1, 2000) == 1) {
    if(@sysvar::CrashSafety::SafetyBreach == 0) TestStepPass("Result", "Safe Latency: %d ms", @sysvar::CrashSafety::CrashToACU_Latency);
    else TestStepFail("Result", "Unsafe Latency: %d ms", @sysvar::CrashSafety::CrashToACU_Latency);
  } else TestStepFail("Timeout", "No deployment");
}

testcase TC2_Low_Intensity_Flood() {
  TestCaseTitle("TC2", "Low Intensity Noise (Algorithm OFF)");
  TestCaseDescription("Validates that minor noise does not cause ISO-26262 breach.");
  ResetTestState();
  @sysvar::FaultInjection::BurstIntensity = 0; // Low
  @sysvar::FaultInjection::ScenarioType = 1;
  @sysvar::FaultInjection::InjectFault = 1;
  testWaitForTimeout(2000);
  
  @sysvar::CrashSafety::SimulateCrash = 1;
  if(testWaitForSysVar(sysvar::CrashSafety::AirbagDeployed, 1, 2000) == 1) {
    if(@sysvar::CrashSafety::SafetyBreach == 0) TestStepPass("Result", "Safe Latency: %d ms", @sysvar::CrashSafety::CrashToACU_Latency);
    else TestStepFail("Result", "Unsafe Latency: %d ms", @sysvar::CrashSafety::CrashToACU_Latency);
  }
}

testcase TC3_Medium_Intensity_Flood() {
  TestCaseTitle("TC3", "Medium Intensity Flood (Algorithm OFF)");
  TestCaseDescription("Validates moderate congestion behavior (15ms delay). Still passes ISO 30ms rule.");
  ResetTestState();
  @sysvar::FaultInjection::BurstIntensity = 1; // Medium
  @sysvar::FaultInjection::ScenarioType = 1;
  @sysvar::FaultInjection::InjectFault = 1;
  testWaitForTimeout(2000);
  
  @sysvar::CrashSafety::SimulateCrash = 1;
  if(testWaitForSysVar(sysvar::CrashSafety::AirbagDeployed, 1, 2000) == 1) {
    if(@sysvar::CrashSafety::SafetyBreach == 0) TestStepPass("Result", "Moderate Latency (Safe): %d ms", @sysvar::CrashSafety::CrashToACU_Latency);
    else TestStepFail("Result", "Unsafe Latency: %d ms", @sysvar::CrashSafety::CrashToACU_Latency);
  }
}

testcase TC4_High_Intensity_Burst() {
  TestCaseTitle("TC4", "High Intensity Burst - CATASTROPHIC FAILURE (Algorithm OFF)");
  TestCaseDescription("Proves that without defense, severe congestion breaches ISO-26262 laws.");
  ResetTestState();
  @sysvar::FaultInjection::BurstIntensity = 2; // High
  @sysvar::FaultInjection::ScenarioType = 1;
  @sysvar::FaultInjection::InjectFault = 1;
  testWaitForTimeout(2000);
  
  @sysvar::CrashSafety::SimulateCrash = 1;
  if(testWaitForSysVar(sysvar::CrashSafety::AirbagDeployed, 1, 2000) == 1) {
    if(@sysvar::CrashSafety::SafetyBreach == 1) TestStepPass("Result", "SUCCESSFUL FAILURE: Network collapsed. Latency %d ms > 30ms limit.", @sysvar::CrashSafety::CrashToACU_Latency);
    else TestStepFail("Result", "Did not fail. Latency: %d ms", @sysvar::CrashSafety::CrashToACU_Latency);
  }
}

testcase TC5_High_Intensity_Burst_Defended() {
  TestCaseTitle("TC5", "High Intensity Burst (Algorithm ON)");
  TestCaseDescription("Proves algorithm defends against sudden high-intensity bursts.");
  ResetTestState();
  @sysvar::LoadManager::Threshold = 70.0;
  @sysvar::FaultInjection::BurstIntensity = 2; // High
  @sysvar::FaultInjection::ScenarioType = 1;
  @sysvar::FaultInjection::InjectFault = 1;
  testWaitForTimeout(4000); // Wait for deferral
  
  @sysvar::CrashSafety::SimulateCrash = 1;
  if(testWaitForSysVar(sysvar::CrashSafety::AirbagDeployed, 1, 2000) == 1) {
    if(@sysvar::CrashSafety::SafetyBreach == 0 && @sysvar::LoadManager::DeferralActive == 1) 
      TestStepPass("Result", "DEFENDED: Latency %d ms. Deferral was Active.", @sysvar::CrashSafety::CrashToACU_Latency);
    else TestStepFail("Result", "Failed Defense. Latency: %d ms", @sysvar::CrashSafety::CrashToACU_Latency);
  }
}

testcase TC6_High_Intensity_Ramp_Defended() {
  TestCaseTitle("TC6", "High Intensity Ramp Attack (Algorithm ON)");
  TestCaseDescription("Proves algorithm dynamically catches a slowly rising load.");
  ResetTestState();
  @sysvar::LoadManager::Threshold = 70.0;
  @sysvar::FaultInjection::BurstIntensity = 2; 
  @sysvar::FaultInjection::ScenarioType = 2; // Ramp
  @sysvar::FaultInjection::InjectFault = 1;
  testWaitForTimeout(6000); // Ramp takes time
  
  @sysvar::CrashSafety::SimulateCrash = 1;
  if(testWaitForSysVar(sysvar::CrashSafety::AirbagDeployed, 1, 2000) == 1) {
    if(@sysvar::CrashSafety::SafetyBreach == 0) TestStepPass("Result", "DEFENDED RAMP: Latency %d ms.", @sysvar::CrashSafety::CrashToACU_Latency);
    else TestStepFail("Result", "Failed Defense. Latency: %d ms", @sysvar::CrashSafety::CrashToACU_Latency);
  }
}

testcase TC7_High_Intensity_Cascade_Defended() {
  TestCaseTitle("TC7", "High Intensity Cascade Attack (Algorithm ON)");
  TestCaseDescription("Proves algorithm defends against distributed multi-ID attacks.");
  ResetTestState();
  @sysvar::LoadManager::Threshold = 70.0;
  @sysvar::FaultInjection::BurstIntensity = 2; 
  @sysvar::FaultInjection::ScenarioType = 3; // Cascade
  @sysvar::FaultInjection::InjectFault = 1;
  testWaitForTimeout(4000); 
  
  @sysvar::CrashSafety::SimulateCrash = 1;
  if(testWaitForSysVar(sysvar::CrashSafety::AirbagDeployed, 1, 2000) == 1) {
    if(@sysvar::CrashSafety::SafetyBreach == 0) TestStepPass("Result", "DEFENDED CASCADE: Latency %d ms.", @sysvar::CrashSafety::CrashToACU_Latency);
    else TestStepFail("Result", "Failed Defense. Latency: %d ms", @sysvar::CrashSafety::CrashToACU_Latency);
  }
}

testcase TC8_False_Positive_Check() {
  TestCaseTitle("TC8", "False Positive Immunity");
  TestCaseDescription("Ensures normal baseline traffic does not accidentally trigger the algorithm when armed.");
  ResetTestState();
  @sysvar::LoadManager::Threshold = 70.0; // Armed, but no fault
  testWaitForTimeout(3000); 
  
  if(@sysvar::LoadManager::DeferralActive == 0) {
    TestStepPass("Result", "No false positive. Deferral remained OFF.");
  } else {
    TestStepFail("Result", "Algorithm falsely triggered during normal traffic.");
  }
}

testcase TC9_Alpha_Too_Slow_Vulnerability() {
  TestCaseTitle("TC9", "Mathematical Vulnerability (Alpha = 0.01)");
  TestCaseDescription("Proves that an incorrectly tuned EWMA (Alpha too low) reacts too slowly to prevent a sudden crash delay.");
  ResetTestState();
  @sysvar::LoadManager::Threshold = 70.0;
  @sysvar::LoadManager::Alpha = 0.01; // Severely slow math
  
  @sysvar::FaultInjection::BurstIntensity = 2; 
  @sysvar::FaultInjection::ScenarioType = 1; 
  @sysvar::FaultInjection::InjectFault = 1;
  
  // Wait only 1 second -- algorithm is too slow to catch it in time!
  testWaitForTimeout(1000); 
  
  @sysvar::CrashSafety::SimulateCrash = 1;
  if(testWaitForSysVar(sysvar::CrashSafety::AirbagDeployed, 1, 2000) == 1) {
    if(@sysvar::CrashSafety::SafetyBreach == 1 && @sysvar::LoadManager::DeferralActive == 0) {
      TestStepPass("Result", "SUCCESSFUL FAILURE: Slow Alpha failed to activate deferral in time. Latency %d ms.", @sysvar::CrashSafety::CrashToACU_Latency);
    } else {
      TestStepFail("Result", "Anomaly: Latency %d, Deferral %d", @sysvar::CrashSafety::CrashToACU_Latency, @sysvar::LoadManager::DeferralActive);
    }
  }
}
