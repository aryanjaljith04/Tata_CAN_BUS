/* ADAS_ECU.can */
variables {
  msTimer adasTimer;
  message 0x201 adasSensor;
  message 0x200 adasAlert;
  float   dist       = 0.0;
  float   speed      = 0.0;
  int i = 0;
}

on start {
  adasSensor.dlc = 4;
  adasAlert.dlc  = 1;
  @sysvar::NodeStatus::Node_ADAS_Status = 1;
  setTimer(adasTimer, 100);
}

on timer adasTimer {
  dist  = 50.0 + (random(5000) * 0.1);
  speed = 45.0 + (random(2000) * 0.01);

  adasSensor.word(0) = (word)(dist  / 0.1);
  adasSensor.word(2) = (word)(speed / 0.01);
  
  for(i=0; i<4; i++) {
    output(adasSensor);
  }

  if(dist < 100.0) {
    adasAlert.byte(0) = 0x21;
    output(adasAlert);
  }

  setTimer(adasTimer, 100);
}
